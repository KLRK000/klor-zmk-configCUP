## Kconfig.defconfig
```kconfig
if SHIELD_KLOR_LEFT

config ZMK_KEYBOARD_NAME
    default "KLOR"

config ZMK_SPLIT_BLE_ROLE_CENTRAL
    default y

endif # LEFT

if SHIELD_KLOR_LEFT || SHIELD_KLOR_RIGHT

    config ZMK_SPLIT
        default y

if ZMK_DISPLAY

    config I2C
        default y

    config SSD1306
        default y

choice ZMK_DISPLAY_STATUS_SCREEN
    default ZMK_DISPLAY_STATUS_SCREEN_CUSTOM
endchoice

if !ZMK_SPLIT || ZMK_SPLIT_ROLE_CENTRAL

config ZMK_DISPLAY_STATUS_SCREEN_CUSTOM
    select LV_FONT_MONTSERRAT_16
    select LV_FONT_MONTSERRAT_12
    select LV_USE_IMG
    select LV_USE_CANVAS
    select LV_USE_LABEL
    select ZMK_WPM

endif # !ZMK_SPLIT || ZMK_SPLIT_ROLE_CENTRAL

endif # ZMK_DISPLAY


if LVGL

    config LV_Z_VDB_SIZE
        default 100

    config LV_DPI_DEF
        default 155

    config LV_Z_MEM_POOL_SIZE
        default 4096 if ZMK_DISPLAY_STATUS_SCREEN_CUSTOM

    config LV_Z_BITS_PER_PIXEL
        default 1

    choice LV_COLOR_DEPTH
        default LV_COLOR_DEPTH_1
    endchoice



endif # LVGL


endif # LEFT RIGHT


if SHIELD_KLOR_RIGHT

config ZMK_DISPLAY
    select LV_USE_IMG
    select LV_USE_CANVAS
    select LV_USE_LABEL
    select LV_FONT_MONTSERRAT_16
endif
```
